## package/boot/uboot-rockchip/patches/firefly_rk3229_defconfig
```kconfig
CONFIG_ARM=y
CONFIG_ARCH_ROCKCHIP=y
CONFIG_MACH_RK3229=y
CONFIG_SYS_TEXT_BASE=0x00200000
CONFIG_SPL_STACK_R_ADDR=0x68100000
CONFIG_DEFAULT_DEVICE_TREE="rk3229-firefly"
CONFIG_OF_LIST="rk3229-firefly"
CONFIG_CMD_GPIO=y
CONFIG_CMD_I2C=y
CONFIG_CMD_MMC=y
CONFIG_CMD_USB=y
CONFIG_CMD_USB_MASS_STORAGE=y
CONFIG_CMD_UBI=y
CONFIG_CMD_UBIFS=y
CONFIG_CMD_MTDPARTS=y
CONFIG_MTD_DEVICE=y
CONFIG_MTD_PARTITIONS=y
CONFIG_SPI_FLASH=y
CONFIG_SPI_FLASH_STM=y
CONFIG_ENV_IS_IN_MMC=y
CONFIG_SPL_ENV_SUPPORT=y
CONFIG_ENV_SIZE=0x2000
CONFIG_ENV_OFFSET=0x100000
CONFIG_FIT=y
CONFIG_FIT_SIGNATURE=y
CONFIG_RSA=y
CONFIG_BOOTDELAY=3
CONFIG_HUSH_PARSER=y
CONFIG_SYS_PROMPT="OpenWrt # "
CONFIG_LOGLEVEL=5
CONFIG_DEBUG_UART=y
CONFIG_DEBUG_UART_BASE=0x10006000
CONFIG_DEBUG_UART_CLOCK=24000000
CONFIG_ARMV7_SECURE_BASE=0x0
CONFIG_ARMV7_NS_BANKED=y
CONFIG_DISPLAY_BOARDINFO=y
CONFIG_ROCKCHIP_I2C=y
CONFIG_ROCKCHIP_SERIAL=y
CONFIG_ROCKCHIP_SPI=y
CONFIG_ROCKCHIP_SYSCON=y
CONFIG_ROCKCHIP_PMU=y
CONFIG_CLK=y
CONFIG_PINCTRL=y
CONFIG_PINCTRL_ROCKCHIP=y
CONFIG_DM_ETH=y
CONFIG_NET_RANDOM_ETHADDR=y
CONFIG_PHYLIB=y
CONFIG_PHY_MICREL=y
CONFIG_PHY_REALTEK=y
CONFIG_USB=y
CONFIG_USB_EHCI_HCD=y
CONFIG_USB_STORAGE=y
CONFIG_USB_KEYBOARD=y
CONFIG_DM_MMC=y
CONFIG_MMC_SDHCI=y
CONFIG_MMC_SDHCI_GENERIC=y
CONFIG_MTD_NAND=y
CONFIG_MTD_NAND_DENALI=y
CONFIG_MTD_NAND_DENALI_SPARE_AREA_SKIP_BYTES=2
```
